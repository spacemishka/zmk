## app/boards/shields/dumbpad_nano/Kconfig.defconfig
```kconfig
if SHIELD_DUMBPAD_NANO

config ZMK_KEYBOARD_NAME
	default "Dumbpad (nice!nano)"

endif
```

## app/boards/shields/ethapadm/Kconfig.shield
```kconfig
# Copyright (c) 2026 The ZMK Contributors
# SPDX-License-Identifier: MIT

config SHIELD_ETHAPADM
    def_bool $(shields_list_contains,ethapadm)
```

## app/boards/shields/kone/Kconfig.defconfig
```kconfig
# Copyright (c) 2021 The ZMK Contributors
# SPDX-License-Identifier: MIT

if SHIELD_EKEEB

config ZMK_KEYBOARD_NAME
	default "ekeeb"

config SPI
    default y

if ZMK_DISPLAY

config I2C
	default y

config SSD1306
	default y

endif # ZMK_DISPLAY

# LVGL configuration removed - these symbols no longer exist in newer Zephyr versions
# if LVGL
# config LVGL_VDB_SIZE
# 	default 64
# config LVGL_DPI
# 	default 148
# config LVGL_BITS_PER_PIXEL
# 	default 1
# choice LVGL_COLOR_DEPTH
# 	default LVGL_COLOR_DEPTH_1
# endchoice
# endif # LVGL

endif
```
